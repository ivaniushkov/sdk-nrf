## subsys/bluetooth/sdc_log/Kconfig
```kconfig
#
# Copyright (c) 2025 Nordic Semiconductor ASA
#
# SPDX-License-Identifier: LicenseRef-Nordic-5-Clause
#

config BT_CTLR_SDC_LOG
	bool "Enable SoftDevice Controller logging"
	depends on BT_LL_SOFTDEVICE_MULTIROLE
	depends on SOC_SERIES_NRF54L || SOC_SERIES_BSIM_NRF54LX
	select MPSL_LOG_HANDLER
	select EXPERIMENTAL
	help
	  Contribute the SoftDevice Controller message table to the shared MPSL
	  log handler (see CONFIG_MPSL_LOG_HANDLER), independently of
	  CONFIG_MPSL_LOG. Can be used to simplify debugging of HCI errors or
	  other kinds of SDC failures.
	  Note: it is only available on the SoftDevice Controller build variant
	  that has logging support built in (see the "logging" feature in
	  dragoon/softdevice_variants_config.yaml and the build_variant
	  selection in dragoon/zephyr/sdc_for_ncs.cmake).
```

## subsys/mpsl/log/Kconfig
```kconfig
#
# Copyright (c) 2025 Nordic Semiconductor ASA
#
# SPDX-License-Identifier: LicenseRef-Nordic-5-Clause
#

config MPSL_LOG_HANDLER
	bool
	select EXPERIMENTAL
	help
	  Enables the tokenized log handler shared by MPSL and the libraries
	  built on top of it (for example the SoftDevice Controller). Each
	  library contributes its own message table; this handler resolves
	  and prints them.
	  Currently selected automatically by MPSL_LOG and by other
	  contributors (for example CONFIG_BT_CTLR_SDC_LOG).

config MPSL_LOG
	bool "MPSL tokenized logging"
	depends on MPSL
	select MPSL_LOG_HANDLER
	select EXPERIMENTAL
	help
	  Enable MPSL's own tokenized log message table, printed through the
	  shared log handler (see CONFIG_MPSL_LOG_HANDLER). Other libraries built
	  on top of MPSL (for example the SoftDevice Controller, see
	  CONFIG_BT_CTLR_SDC_LOG) can contribute their own message table to the
	  same handler independently of this option.
	  Note: it is only available on some builds of MPSL.

if MPSL_LOG_HANDLER

choice MPSL_LOG_HANDLER_TYPE
	prompt "MPSL log handler"
	default MPSL_LOG_HANDLER_BUILTIN

config MPSL_LOG_HANDLER_BUILTIN
	bool "Built-in Zephyr logging handler"
	select LOG
	help
	  Default handler using a separate thread and log FIFO.

config MPSL_LOG_HANDLER_CUSTOM
	bool "Custom application-provided handler"
	help
	  User-defined log handler.
	  It shall implement all the mandatory MPSL log callbacks.

endchoice

config MPSL_LOG_PRINT_LEVEL
	int "MPSL log print level"
	default 3
	range 0 4
	help
	  Log message severity printed by the built-in handler.

if MPSL_LOG_HANDLER_BUILTIN

config MPSL_LOG_FIFO_SIZE
	int "MPSL log FIFO size"
	default 32
	help
	  Number of log messages that can be enqueued before dropping.

config MPSL_LOG_THREAD_STACK_SIZE
	int "MPSL log thread stack size"
	default 512
	help
	  Stack size for the thread that drains the log FIFO and prints messages.

endif # MPSL_LOG_HANDLER_BUILTIN

endif # MPSL_LOG_HANDLER
```
